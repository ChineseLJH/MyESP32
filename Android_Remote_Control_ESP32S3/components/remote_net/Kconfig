## Android_Remote_Control_ESP32S3/components/remote_net/Kconfig
```kconfig
menu "Remote Control Network"

    config RNET_WIFI_SSID
        string "WiFi SSID"
        default "chineseljh"
        help
            The SSID of the WiFi AP to connect to.

    config RNET_WIFI_PASSWORD
        string "WiFi Password"
        default "12345678"
        help
            The password of the WiFi AP.

    config RNET_UDP_CONTROL_PORT
        int "UDP Control Port"
        default 6666
        help
            Port for the UDP remote control commands.

    config RNET_UDP_PORT
        int "UDP Broadcast Port"
        default 54321
        help
            Port for device discovery broadcast.

endmenu
```

## ESP_Architect_Labs/Lab06_Raw_NetStack/components/bsp_network/Kconfig
```kconfig
menu "Lab06_BSP_NetWork"

    config WIFI_SSID
        string "WiFi SSID"
        default "chineseljh"
        help
            The SSID of the WiFi AP to connect to.

    config WIFI_PASSWORD
        string "WiFi Password"
        default "12345678"
        help
            The password of the WiFi AP.

    config MAXIMUM_RETRY
        int "MaxNum Retry"
        default 5
        range 1 10
        help
            Maximum number of retries before giving up the connection.

endmenu
```

## ESP_Architect_Labs/Lab06_Raw_NetStack/components/raw_netstack/Kconfig
```kconfig
menu "Lab06_Raw_NetStack"

    config RAW_NETSTACK_TCP_PORT
        int "TCP Server Listen Port"
        default 3333
        range 1024 65535
        help
            The port number that the standard POSIX TCP server will bind and listen to.
            Ports under 1024 are reserved for well-known services.

    config RAW_NETSTACK_LISTEN_BACKLOG
        int "TCP Listen Backlog Size"
        default 5
        range 1 32
        help
            The maximum length to which the queue of pending connections for listen_fd may grow.

    config RAW_NETSTACK_TASK_STACK_SIZE
        int "TCP Server Task Stack Size"
        default 4096
        help
            Stack size for the FreeRTOS task running the socket server.

    config RAW_NETSTACK_TASK_PRIORITY
        int "TCP Server Task Priority"
        default 5
        range 1 25
        help
            FreeRTOS task priority.

    config TCP_KEEP_IDLE
        int "TCP Keep-Alive Idle Time (s)"
        default 5
        help
            Idle time before sending the first keep-alive probe.

    config TCP_KEEP_INTERVAL
        int "TCP Keep-Alive Interval (s)"
        default 2
        help
            Time between subsequent keep-alive probes.

    config TCP_KEEP_COUNT
        int "TCP Keep-Alive Count"
        default 3
        help
            Number of unacknowledged probes before considering the connection dead.

endmenu
```
