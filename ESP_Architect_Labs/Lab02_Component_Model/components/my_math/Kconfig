## ESP_Architect_Labs/Lab02_Component_Model/components/my_math/Kconfig
```kconfig
menu "Lab02_Component_Model"

    config MY_MATH_ADD
        bool "USE My_add(int a,int b)"
        default "y"
        help
            you can use My_add in your project.

    config MY_MATH_MULTIPLY
        bool "USE My_multiply(int a,int b)"
        default "n"
        help
            you can use My_multiply in your project.


endmenu
```

## ESP_Architect_Labs/Lab04_Multicore_SMP/components/concurrency_testing/Kconfig
```kconfig
menu "Lab04_Kconfig"

    choice
        prompt "Select Protection Method"
        default SMP_RACE_CONDITION_NONE
        help
            Select the synchronization mechanism to protect the shared counter.
            This determines how the two CPU cores will compete for the resource.

        config SMP_RACE_CONDITION_NONE
            bool "No Protection"
            help
                Do not use any lock. This should demonstrate a race condition error.

        config SMP_RACE_CONDITION_SPINLOCK
            bool "Protect with Spinlock"
            help
                Use a spinlock (atomic loop) to protect the critical section.
                CPU will busy-wait if the lock is taken.

        config SMP_RACE_CONDITION_MUTEX
            bool "Protect with Mutex"
            help
                Use a FreeRTOS Mutex to protect the critical section.
                Task will yield/sleep if the lock is taken.

    endchoice

endmenu
```

## ESP_Architect_Labs/Lab05_Interrupt_HAL_ZeroCopy_IPC/components/ipc_throughput/Kconfig
```kconfig
menu "Lab05_Interrupt_HAL_ZeroCopy_IPC"

    choice
        prompt "IPC Transfer Strategy"
        default IPC_MODE_COPY
        help
            Select the strategy for passing data from ISR to Task.

        config IPC_MODE_COPY
            bool "Naive Copy (Low Performance)"
            help
                FULL COPY. The ISR copies the entire 1KB struct into the Queue.
                This blocks the CPU inside the interrupt handler.

        config IPC_MODE_ZERO_COPY
            bool "Zero Copy (High Performance)"
            help
                POINTER ONLY. The ISR only passes a 4-byte pointer.
                Requires a memory pool implementation.

    endchoice

    config IPC_TIMER_INTERVAL_US
        int "Interrupt Interval (us)"
        default 1000
        range 5 1000000
        help
            Timer interrupt period.
            1000us = 1kHz (Low load)
            200us  = 5kHz (High load)
            100us  = 10kHz (Stress test)

endmenu
```
